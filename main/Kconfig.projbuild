## main/Kconfig.projbuild
```kconfig
menu "Porject Configuration"

    menu "I2C Master"
        config I2C_MASTER_SCL
            int "SCL GPIO Num"
            default 3
            help
                GPIO number for I2C Master clock line.

        config I2C_MASTER_SDA
            int "SDA GPIO Num"
            default 33
            help
                GPIO number for I2C Master data line.

        config I2C_MASTER_PORT_NUM
            int "Port Number"
            default 1
            help
                Port number for I2C Master device.

        config I2C_MASTER_FREQUENCY
            int "Master Frequency"
            default 100000
            help
                I2C Speed of Master device.
    endmenu
    menu "WiFi Connection"
        config ESP_WIFI_SSID
            string "WiFi SSID"
            default "myssid"
            help
                SSID (network name) for the example to connect to.
        config ESP_WIFI_PASSWORD
            string "WiFi Password"
            default "mypassword"
            help
                WiFi password (WPA or WPA2) for the example to use.
        config ESP_MAXIMUM_RETRY
            int "Maximum retry"
            default 5
            help
                Set the Maximum retry to avoid station reconnecting to the AP unlimited when the AP is really inexistent.
    endmenu
endmenu
```

## sdkconfig.defaults
```kconfig
CONFIG_SPIRAM_SUPPORT=y
CONFIG_ESP_CONSOLE_UART=y
CONFIG_ESP_CONSOLE_MULTIPLE_UART=y
CONFIG_ESP_CONSOLE_UART_CUSTOM=y
CONFIG_ESP_CONSOLE_UART_CUSTOM_NUM_0=y
CONFIG_ESP_CONSOLE_UART_NUM=0
CONFIG_ESP_CONSOLE_UART_TX_GPIO=1
CONFIG_ESP_CONSOLE_UART_RX_GPIO=0
CONFIG_FATFS_LFN_HEAP=y
CONFIG_PARTITION_TABLE_CUSTOM=y
CONFIG_PARTITION_TABLE_CUSTOM_FILENAME="partitions.csv"
CONFIG_ESPTOOLPY_FLASHSIZE_4MB=y
CONFIG_FREERTOS_TIMER_TASK_STACK_DEPTH=8192
```
